## HUD/sdkconfig.defaults
```kconfig
CONFIG_BT_ENABLED=y
CONFIG_BT_NIMBLE_ENABLED=y
CONFIG_BT_CONTROLLER_ENABLED=y
CONFIG_BT_CLASSIC_ENABLED=n
CONFIG_BT_NIMBLE_MAX_BONDS=1
CONFIG_BT_NIMBLE_ATT_PREFERRED_MTU=517
CONFIG_BT_NIMBLE_SVC_GAP_DEVICE_NAME="WYNHUD"
CONFIG_BT_NIMBLE_MAX_CCCDS=6
CONFIG_BT_NIMBLE_GATT_MAX_PROCS=4
CONFIG_BT_NIMBLE_GATT_SVR_MAX_SVCS=4
CONFIG_BT_NIMBLE_GATT_SVR_MAX_CHRS=8
CONFIG_BT_NIMBLE_GATT_SVR_MAX_DSCS=0
```
